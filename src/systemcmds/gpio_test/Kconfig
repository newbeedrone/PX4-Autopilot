## src/systemcmds/gpio_test/Kconfig
```kconfig
menuconfig SYSTEMCMDS_GPIO_TEST
	bool "gpio_test"
	default n
	depends on PLATFORM_NUTTX
	---help---
		Isolated manufacturing GPIO waveform and frequency measurement tool.

if SYSTEMCMDS_GPIO_TEST
config GPIO_TEST_PROTOCOLS
	bool "Enable isolated connector protocol tests"
	default n
	---help---
		I2C slave simulation, UART receiver simulation, external CAN pairing,
		and Ethernet UDP checks. Requires the matching board adapter and GUI.

config GPIO_TEST_RECEIVER
	bool "Build an input-only measurement endpoint"
	default n

config GPIO_TEST_PROFILE
	string "GPIO test wiring profile relative to the repository root"
	default ""
endif
```
